## components/analog_input/Kconfig
```kconfig
menu "Analog Input Configuration"

    config ANALOG_INPUT_1_GPIO
        int "Analog Input 1 GPIO"
        default 4
        help
            GPIO pin for analog input 1 (0-10V).

    config ANALOG_INPUT_1_ADC_CHANNEL
        int "Analog Input 1 ADC Channel"
        default 3
        help
            ADC1 channel number for analog input 1 (GPIO4 = ADC1_CH3).

    config ANALOG_INPUT_2_GPIO
        int "Analog Input 2 GPIO"
        default 5
        help
            GPIO pin for analog input 2 (0-10V).

    config ANALOG_INPUT_2_ADC_CHANNEL
        int "Analog Input 2 ADC Channel"
        default 4
        help
            ADC1 channel number for analog input 2 (GPIO5 = ADC1_CH4).

    config ANALOG_INPUT_DIVIDER_RATIO
        int "Voltage divider ratio (x1000)"
        default 11000
        help
            Ratio of terminal voltage to ADC pin voltage, multiplied by 1000.
            Example: 100k+10k divider = divide by 11 -> 11000.

endmenu
```

## components/app_logic/Kconfig
```kconfig
menu "Application Logic Configuration"

    config APP_LOGIC_TASK_STACK_SIZE
        int "App Logic Task Stack Size"
        default 4096

    config APP_LOGIC_TASK_PRIORITY
        int "App Logic Task Priority"
        default 5

    config APP_PUBLISH_STATUS_INTERVAL_SEC
        int "System Status Publish Interval (seconds)"
        default 300
        help
            How often to publish system health parameters to MQTT status topic.

    config APP_IRRIGATION_HYSTERESIS_PCT
        int "Auto-irrigation re-arm hysteresis percentage"
        range 0 50
        default 5
        help
            Auto-irrigation starts below the configured moisture threshold and
            re-arms only after moisture rises at least this many percentage
            points above that threshold.

endmenu
```

## components/digital_input/Kconfig
```kconfig
menu "Digital Input Configuration"

    config DIGITAL_INPUT_1_GPIO
        int "Digital Input 1 GPIO"
        default 16
        help
            GPIO pin for digital input 1 (dry contact).

    config DIGITAL_INPUT_2_GPIO
        int "Digital Input 2 GPIO"
        default 17
        help
            GPIO pin for digital input 2 (dry contact).

endmenu
```

## components/ethernet_manager/Kconfig
```kconfig
menu "Ethernet W5500 Configuration"

    config ETH_SPI_MOSI
        int "W5500 SPI MOSI GPIO"
        default 43

    config ETH_SPI_MISO
        int "W5500 SPI MISO GPIO"
        default 44

    config ETH_SPI_SCK
        int "W5500 SPI SCK GPIO"
        default 42

    config ETH_SPI_CS
        int "W5500 SPI CS GPIO"
        default 41

    config ETH_INT_GPIO
        int "W5500 Interrupt GPIO"
        default 2

    config ETH_RST_GPIO
        int "W5500 Reset GPIO"
        default 1

    config ETH_POLL_PERIOD_MS
        int "W5500 Poll Period (ms)"
        default 50

endmenu
```

## components/lcd_display/Kconfig
```kconfig
menu "LCD Display Configuration"

    config LCD_I2C_SDA
        int "LCD I2C SDA GPIO"
        default 48

    config LCD_I2C_SCL
        int "LCD I2C SCL GPIO"
        default 47

    config LCD_REFRESH_INTERVAL_SEC
        int "LCD Refresh Interval (seconds)"
        default 5

endmenu
```

## components/modem_manager/Kconfig
```kconfig
menu "Modem Manager Configuration"

    config MODEM_UART_TX_PIN
        int "Modem UART TX GPIO"
        default 10
        help
            GPIO pin connected to Modem RX. KC868-A2v3: GPIO10.

    config MODEM_UART_RX_PIN
        int "Modem UART RX GPIO"
        default 9
        help
            GPIO pin connected to Modem TX. KC868-A2v3: GPIO9.

    config MODEM_UART_RTS_PIN
        int "Modem UART RTS GPIO (-1 to disable)"
        default -1

    config MODEM_UART_CTS_PIN
        int "Modem UART CTS GPIO (-1 to disable)"
        default -1

    config MODEM_UART_BAUD_RATE
        int "Modem UART Baud Rate"
        default 115200

    config MODEM_POWER_PIN
        int "Modem PWRKEY GPIO Pin"
        default -1
        help
            PWRKEY pin for power-cycling the modem. -1 to disable.

    config MODEM_POWER_ON_PULSE_MS
        int "Modem Power-On Pulse Duration (ms)"
        default 1000

    config MODEM_APN
        string "Cellular APN"
        default "internet"

    config MODEM_UART_RX_BUFFER_SIZE
        int "Modem UART RX Buffer Size"
        default 4096

    config MODEM_UART_TX_BUFFER_SIZE
        int "Modem UART TX Buffer Size"
        default 512

endmenu
```

## components/mqtt_client_wrapper/Kconfig
```kconfig
menu "MQTT Client Configuration"

    config MQTT_BROKER_URI
        string "Default MQTT Broker URI"
        default "mqtt://broker.hivemq.com"

    config MQTT_DEVICE_ID_PREFIX
        string "MQTT Topic Path Prefix"
        default "kca2v3"
        help
            Prefix used in topic paths: prefix/{device_id}/sensors.

endmenu
```

## components/onewire_sensor/Kconfig
```kconfig
menu "1-Wire Sensor Configuration"

    config ONEWIRE_TMP1_GPIO
        int "1-Wire TMP1 GPIO Pin"
        default 18
        help
            GPIO pin for DS18B20 temperature sensor 1.

    config ONEWIRE_TMP2_GPIO
        int "1-Wire TMP2 GPIO Pin"
        default 8
        help
            GPIO pin for DS18B20 temperature sensor 2.

endmenu
```

## components/relay_control/Kconfig
```kconfig
menu "Relay Control Configuration"

    config RELAY_1_GPIO
        int "Relay 1 GPIO"
        default 40
        help
            GPIO pin for Relay 1. KC868-A2v3 default: GPIO40.

    config RELAY_2_GPIO
        int "Relay 2 GPIO"
        default 39
        help
            GPIO pin for Relay 2. KC868-A2v3 default: GPIO39.

    config RELAY_ACTIVE_LOW
        bool "Relays are Active-Low"
        default y
        help
            If set, GPIO LOW activates relay; HIGH activates otherwise.

    config RELAY_MAX_ON_TIME_SEC
        int "Relay Max On Time (Seconds)"
        default 3600
        help
            Maximum time a relay can stay active on timed operation.

endmenu
```

## components/rs485_manager/Kconfig
```kconfig
menu "RS485 Configuration"

    config RS485_TXD
        int "RS485 TXD GPIO"
        default 7

    config RS485_RXD
        int "RS485 RXD GPIO"
        default 15

    config RS485_BAUD_RATE
        int "RS485 Baud Rate"
        default 9600

endmenu
```

## components/rtc_manager/Kconfig
```kconfig
menu "RTC Manager Configuration"

    config RTC_I2C_SDA
        int "I2C SDA GPIO"
        default 48
        help
            I2C data pin. KC868-A2v3 default: GPIO48.

    config RTC_I2C_SCL
        int "I2C SCL GPIO"
        default 47
        help
            I2C clock pin. KC868-A2v3 default: GPIO47.

endmenu
```

## components/sd_card_logger/Kconfig
```kconfig
menu "SD Card Logger Configuration"

    config SD_SPI_MOSI
        int "SD Card SPI MOSI GPIO"
        default 12

    config SD_SPI_SCK
        int "SD Card SPI SCK GPIO"
        default 13

    config SD_SPI_MISO
        int "SD Card SPI MISO GPIO"
        default 14

    config SD_SPI_CS
        int "SD Card SPI CS GPIO"
        default 11

    config SD_SPI_CD
        int "SD Card Card Detect GPIO (-1 to disable)"
        default 21
        help
            Card detect pin. KC868-A2v3: GPIO21. Set to -1 if not used.

endmenu
```

## components/sensor_hub/Kconfig
```kconfig
menu "Sensor Hub Configuration"

    config SENSOR_READ_INTERVAL_MS
        int "Sensor Reading Interval (ms)"
        default 30000
        help
            How often to read sensors.

endmenu
```

## components/system_monitor/Kconfig
```kconfig
menu "System Monitor Configuration"

    config SYSMON_REPORT_INTERVAL_SEC
        int "System Monitor Report Interval (seconds)"
        default 60
        help
            How often the system monitor task logs heap stats.

    config SYSMON_LOW_HEAP_THRESHOLD
        int "Low Free Heap Size Warning Threshold (bytes)"
        default 8192
        help
            Log warning level message if free heap falls below this value.

endmenu
```

## main/Kconfig.projbuild
```kconfig
menu "KC868-A2v3 Smart Controller Configuration"

    config APP_VERSION
        string "Firmware Version"
        default "1.0.0"
        help
            Version string of the firmware application.

    config FREEGPIO_ENABLE
        bool "Initialize Free GPIOs as Inputs"
        default y
        help
            Configure free GPIOs (4, 5, 6, 38) as inputs with pull-up.
            Disable if you plan to use them directly in custom code.

endmenu
```
