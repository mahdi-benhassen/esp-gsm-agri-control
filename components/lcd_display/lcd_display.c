#include "lcd_display.h"
#include "driver/i2c.h"
#include "esp_log.h"
#include "freertos/FreeRTOS.h"
#include "freertos/task.h"
#include <string.h>

static const char *TAG = "LCD_DISPLAY";

#define SSD1306_ADDR    0x3C
#define I2C_MASTER_PORT I2C_NUM_0
#define SSD1306_WIDTH   128
#define SSD1306_HEIGHT  64
#define SSD1306_PAGES   (SSD1306_HEIGHT / 8)

static uint8_t s_framebuffer[SSD1306_WIDTH * SSD1306_PAGES];
static bool s_initialized = false;
static bool s_enabled = true;

static const uint8_t font_6x8[][6] = {
    {0x00,0x00,0x00,0x00,0x00,0x00}, // space
    {0x00,0x00,0x5F,0x00,0x00,0x00}, // !
    {0x00,0x07,0x00,0x07,0x00,0x00}, // "
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    {0x61,0x51,0x49,0x45,0x43,0x00}, // Z
};

static esp_err_t ssd1306_write_cmd(uint8_t cmd) {
  i2c_cmd_handle_t handle = i2c_cmd_link_create();
  i2c_master_start(handle);
  i2c_master_write_byte(handle, (SSD1306_ADDR << 1) | I2C_MASTER_WRITE, true);
  i2c_master_write_byte(handle, 0x00, true);
  i2c_master_write_byte(handle, cmd, true);
  i2c_master_stop(handle);
  esp_err_t err = i2c_master_cmd_begin(I2C_MASTER_PORT, handle, pdMS_TO_TICKS(100));
  i2c_cmd_link_delete(handle);
  return err;
}

static esp_err_t ssd1306_flush(void) {
  for (int page = 0; page < SSD1306_PAGES; page++) {
    ssd1306_write_cmd(0xB0 + page);
    ssd1306_write_cmd(0x00);
    ssd1306_write_cmd(0x10);

    i2c_cmd_handle_t handle = i2c_cmd_link_create();
    i2c_master_start(handle);
    i2c_master_write_byte(handle, (SSD1306_ADDR << 1) | I2C_MASTER_WRITE, true);
    i2c_master_write_byte(handle, 0x40, true);
    i2c_master_write(handle, &s_framebuffer[page * SSD1306_WIDTH], SSD1306_WIDTH, true);
    i2c_master_stop(handle);
    i2c_master_cmd_begin(I2C_MASTER_PORT, handle, pdMS_TO_TICKS(100));
    i2c_cmd_link_delete(handle);
  }
  return ESP_OK;
}

static void draw_char(int x, int y, char c) {
  if (c < 0x20 || c > 0x5A) c = ' ';
  const uint8_t *glyph = font_6x8[c - 0x20];

  for (int col = 0; col < 6 && (x + col) < SSD1306_WIDTH; col++) {
    int page = y / 8;
    if (page >= SSD1306_PAGES) break;
    s_framebuffer[page * SSD1306_WIDTH + x + col] = glyph[col];
  }
}

static void draw_text(int x, int y, const char *text) {
  while (*text && x < SSD1306_WIDTH) {
    draw_char(x, y, *text++);
    x += 6;
  }
}

esp_err_t lcd_display_init(void) {
  memset(s_framebuffer, 0, sizeof(s_framebuffer));

  ssd1306_write_cmd(0xAE); // Display off
  ssd1306_write_cmd(0xD5); ssd1306_write_cmd(0x80); // Set osc
  ssd1306_write_cmd(0xA8); ssd1306_write_cmd(0x3F); // Mux ratio
  ssd1306_write_cmd(0xD3); ssd1306_write_cmd(0x00); // Offset
  ssd1306_write_cmd(0x40); // Start line
  ssd1306_write_cmd(0x8D); ssd1306_write_cmd(0x14); // Charge pump
  ssd1306_write_cmd(0x20); ssd1306_write_cmd(0x00); // Horiz addr mode
  ssd1306_write_cmd(0xA1); // Segment remap
  ssd1306_write_cmd(0xC8); // COM scan dir
  ssd1306_write_cmd(0xDA); ssd1306_write_cmd(0x12); // COM pins
  ssd1306_write_cmd(0x81); ssd1306_write_cmd(0xCF); // Contrast
  ssd1306_write_cmd(0xD9); ssd1306_write_cmd(0xF1); // Pre-charge
  ssd1306_write_cmd(0xDB); ssd1306_write_cmd(0x40); // VCOMH
  ssd1306_write_cmd(0xA4); // Resume display
  ssd1306_write_cmd(0xA6); // Normal (non-inverted)
  ssd1306_write_cmd(0xAF); // Display on

  s_initialized = true;

  lcd_display_clear();
  lcd_display_show("KC868-A2v3", "Booting...", "");
  lcd_display_flush();

  ESP_LOGI(TAG, "SSD1306 LCD initialized");
  return ESP_OK;
}

esp_err_t lcd_display_clear(void) {
  if (!s_initialized) return ESP_ERR_INVALID_STATE;
  memset(s_framebuffer, 0, sizeof(s_framebuffer));
  return ESP_OK;
}

esp_err_t lcd_display_show_line(int line, const char *text) {
  if (!s_initialized || line < 0 || line > 2) return ESP_ERR_INVALID_ARG;

  int y = line * 8;
  int x = 0;
  draw_text(x, y, text);

  return ESP_OK;
}

esp_err_t lcd_display_show(const char *line1, const char *line2,
                           const char *line3) {
  if (!s_initialized) return ESP_ERR_INVALID_STATE;
  if (!s_enabled) return ESP_OK;

  lcd_display_clear();
  if (line1) lcd_display_show_line(0, line1);
  if (line2) lcd_display_show_line(1, line2);
  if (line3) lcd_display_show_line(2, line3);
  return ssd1306_flush();
}

void lcd_display_set_enabled(bool enabled) {
  s_enabled = enabled;
}

esp_err_t lcd_display_flush(void) {
  if (!s_initialized) return ESP_ERR_INVALID_STATE;
  return ssd1306_flush();
}
