## components/factory_reset/Kconfig
```kconfig
menu "Factory Reset Configuration"

    config FACTORY_RESET_GPIO
        int "Factory Reset GPIO"
        default 38
        help
            GPIO connected to the factory reset button (active-low, pull-up).

    config FACTORY_RESET_HOLD_MS
        int "Factory Reset hold time (ms)"
        default 5000
        range 1000 30000
        help
            How long the button must be held to trigger a factory reset.

endmenu
```

## components/safe_state/Kconfig
```kconfig
menu "Safe State Configuration"

    config SAFE_STATE_DEFAULT_TIMEOUT_SEC
        int "Default safe-state timeout (seconds)"
        default 300
        range 10 3600
        help
            Heartbeat timeout before the safe-state trigger turns all relays OFF.
            Can be overridden at runtime via config_store.

endmenu
```

## components/web_server/Kconfig
```kconfig
menu "Web Server Configuration"

    config WEB_SERVER_ENABLED
        bool "Enable Web Server"
        default y
        help
            Enable embedded HTTP web server and WiFi manager.

    config WEB_SERVER_PORT
        int "Web Server HTTP Port"
        default 80

    config WEB_SERVER_WIFI_AP_SSID
        string "WiFi AP SSID (setup mode)"
        default "KC868-A2v3-Setup"

    config WEB_SERVER_WIFI_AP_PASSWORD
        string "WiFi AP Password (setup mode, min 8 chars)"
        default "admin1234"

    config WEB_SERVER_AUTH_USERNAME
        string "Web UI Username"
        default "admin"
        help
            HTTP Basic Auth username for the web interface.

    config WEB_SERVER_AUTH_PASSWORD
        string "Web UI Password"
        default "admin"
        help
            HTTP Basic Auth password for the web interface.
            CHANGE THIS BEFORE DEPLOYMENT.

    config WEB_SERVER_RATE_LIMIT_MS
        int "API Rate Limit (ms between requests)"
        default 500
        help
            Global minimum time between authenticated API requests.

endmenu
```

## sdkconfig.defaults
```kconfig
# Target ESP32-S3
CONFIG_IDF_TARGET_ESP32S3=y

# Enable PSRAM (N16R8)
CONFIG_SPIRAM=y
CONFIG_SPIRAM_MODE_OCT=y
CONFIG_SPIRAM_SPEED_80M=y
CONFIG_SPIRAM_USE_CAPS_ALLOC=y
CONFIG_SPIRAM_IGNORE_NOTFOUND=y

# Enable LWIP PPP support for cellular
CONFIG_LWIP_PPP_SUPPORT=y
CONFIG_LWIP_PPP_PAP_SUPPORT=y
CONFIG_LWIP_PPP_CHAP_SUPPORT=y
CONFIG_LWIP_PPP_MSCHAP_SUPPORT=y
CONFIG_LWIP_PPP_MPPE_SUPPORT=y
CONFIG_LWIP_TCPIP_TASK_STACK_SIZE=4096
CONFIG_LWIP_PPP_NOTIFY_PHASE_SUPPORT=y

# App defaults
CONFIG_ESP_MAIN_TASK_STACK_SIZE=8192
CONFIG_FREERTOS_HZ=1000

# Hardware watchdogs (critical for industrial reliability)
CONFIG_ESP_TASK_WDT_INIT=y
CONFIG_ESP_TASK_WDT_TIMEOUT_S=30
CONFIG_ESP_TASK_WDT_CHECK_IDLE_TASK_CPU0=y
CONFIG_ESP_TASK_WDT_CHECK_IDLE_TASK_CPU1=y
CONFIG_ESP_INT_WDT=y
CONFIG_ESP_INT_WDT_TIMEOUT_MS=800
CONFIG_ESP_BROWNOUT_DET=y
CONFIG_ESP_BROWNOUT_DET_LVL_SEL_7=y

# Stack protection
CONFIG_COMPILER_STACK_CHECK_MODE_STRONG=y
CONFIG_COMPILER_STACK_CHECK=y

# Heap failure callback
CONFIG_HEAP_POISONING_LIGHT=y

# Logging
CONFIG_LOG_DEFAULT_LEVEL_INFO=y

# MQTT
CONFIG_MQTT_BUFFER_SIZE=2048
CONFIG_MQTT_TASK_STACK_SIZE=8192

# SPI for W5500 Ethernet and SD Card
CONFIG_SPI_MASTER_ISR_IN_IRAM=y

# I2C for RTC, LCD, EEPROM
CONFIG_I2C_ISR_IRAM_SAFE=y

# FATFS for SD Card
CONFIG_FATFS_LFN_HEAP=y
CONFIG_FATFS_MAX_LFN=255

# WiFi + HTTP Server for Web GUI
CONFIG_ESP_WIFI_ENABLED=y
CONFIG_ESP_WIFI_STA_ENABLED=y
CONFIG_ESP_WIFI_AP_ENABLED=y
CONFIG_ESP_WIFI_SOFTAP_SUPPORT=y
CONFIG_HTTPD_MAX_REQ_HDR_LEN=512
CONFIG_HTTPD_MAX_URI_LEN=256

# Custom partition table (16MB flash, 3MB factory)
CONFIG_ESPTOOLPY_FLASHSIZE_16MB=y
CONFIG_ESPTOOLPY_FLASHSIZE="16MB"
CONFIG_PARTITION_TABLE_CUSTOM=y
CONFIG_PARTITION_TABLE_FILENAME="partitions.csv"
```
